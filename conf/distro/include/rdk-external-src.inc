## conf/distro/include/rdk-external-src.inc
```bitbake
#
#
# Note: This feature is for developers ONLY.
# Please do not forget to set BB_ENV_EXTRAWHITE before
# launching the yocto build.
# `export BB_ENV_EXTRAWHITE="${BB_ENV_EXTRAWHITE} RDK_ROOT_PATH"`
#
INHERIT += "externalsrc"

EXTERNALSRC:pn-aamp = "${@'${RDK_ROOT_PATH}/rdk/components/generic/aamp' if (os.path.isdir('${RDK_ROOT_PATH}/rdk/components/generic/aamp')) else ''}"
EXTERNALSRC:pn-analyzers-host = "${@'${RDK_ROOT_PATH}/rdk/components/generic/sys_mon_tools/analyzers/scripts/host' if (os.path.isdir('${RDK_ROOT_PATH}/rdk/components/generic/sys_mon_tools/analyzers/scripts/host')) else ''}"
EXTERNALSRC:pn-analyzers-target = "${@'${RDK_ROOT_PATH}/rdk/components/generic/sys_mon_tools/analyzers/scripts/target' if (os.path.isdir('${RDK_ROOT_PATH}/rdk/components/generic/sys_mon_tools/analyzers/scripts/target')) else ''}"
EXTERNALSRC:pn-appmanager = "${@'${RDK_ROOT_PATH}/rdk/components/generic/appmanager' if (os.path.isdir('${RDK_ROOT_PATH}/rdk/components/generic/appmanager')) else ''}"
EXTERNALSRC:pn-asbluetoothrcu = "${@'${RDK_ROOT_PATH}/rdk/components/generic/blercudaemon' if (os.path.isdir('${RDK_ROOT_PATH}/rdk/components/generic/blercudaemon')) else ''}"
EXTERNALSRC:pn-audiocapturemgr = "${@'${RDK_ROOT_PATH}/rdk/components/generic/audiocapturemgr' if (os.path.isdir('${RDK_ROOT_PATH}/rdk/components/generic/audiocapturemgr')) else ''}"
EXTERNALSRC:pn-bluetooth-core = "${@'${RDK_ROOT_PATH}/rdk/components/generic/bluetooth' if (os.path.isdir('${RDK_ROOT_PATH}/rdk/components/generic/bluetooth')) else ''}"
EXTERNALSRC:pn-bluetooth-leappmgr = "${@'${RDK_ROOT_PATH}/rdk/components/generic/bluetooth_leAppMgr' if (os.path.isdir('${RDK_ROOT_PATH}/rdk/components/generic/bluetooth_leAppMgr')) else ''}"
EXTERNALSRC:pn-bluetooth-mgr = "${@'${RDK_ROOT_PATH}/rdk/components/generic/bluetooth_mgr' if (os.path.isdir('${RDK_ROOT_PATH}/rdk/components/generic/bluetooth_mgr')) else ''}"
EXTERNALSRC:pn-ccsp-epon-agent = "${@'${RDK_ROOT_PATH}/rdkb/components/opensource/ccsp/CcspEPONAgent' if (os.path.isdir('${RDK_ROOT_PATH}/rdkb/components/opensource/ccsp/CcspEPONAgent')) else ''}"
EXTERNALSRC:pn-ccsp-gwprovapp-epon = "${@'${RDK_ROOT_PATH}/rdkb/components/opensource/ccsp/GwProvApp-ePON' if (os.path.isdir('${RDK_ROOT_PATH}/rdkb/components/opensource/ccsp/GwProvApp-ePON')) else ''}"
EXTERNALSRC:pn-ccsp-logagent = "${@'${RDK_ROOT_PATH}/rdkb/components/generic/CcspLogAgent' if (os.path.isdir('${RDK_ROOT_PATH}/rdkb/components/generic/CcspLogAgent')) else ''}"
EXTERNALSRC:pn-ccsp-wifi-agent = "${@'${RDK_ROOT_PATH}/rdkb/components/opensource/ccsp/CcspWifiAgent' if (os.path.isdir('${RDK_ROOT_PATH}/rdkb/components/opensource/ccsp/CcspWifiAgent')) else ''}"
EXTERNALSRC:pn-cobalt-launcher = "${@'${RDK_ROOT_PATH}/rdk/components/generic/cobalt-launcher' if (os.path.isdir('${RDK_ROOT_PATH}/rdk/components/generic/cobalt-launcher')) else ''}"
EXTERNALSRC:pn-configmgr = "${@'${RDK_ROOT_PATH}/rdkc/components/opensource/configMgr' if (os.path.isdir('${RDK_ROOT_PATH}/rdkc/components/opensource/configMgr')) else ''}"
EXTERNALSRC:pn-cpuprocanalyzer = "${@'${RDK_ROOT_PATH}/rdk/components/generic/cpuprocanalyzer' if (os.path.isdir('${RDK_ROOT_PATH}/rdk/components/generic/cpuprocanalyzer')) else ''}"
EXTERNALSRC:pn-crashlog = "${@'${RDK_ROOT_PATH}/rdk/components/generic/crashlog' if (os.path.isdir('${RDK_ROOT_PATH}/rdk/components/generic/crashlog')) else ''}"
EXTERNALSRC:pn-ctrlm-headers = "${@'${RDK_ROOT_PATH}/rdk/components/generic/control' if (os.path.isdir('${RDK_ROOT_PATH}/rdk/components/generic/control')) else ''}"
EXTERNALSRC:pn-ctrlm-main = "${@'${RDK_ROOT_PATH}/rdk/components/generic/control' if (os.path.isdir('${RDK_ROOT_PATH}/rdk/components/generic/control')) else ''}"
EXTERNALSRC:pn-cvr = "${@'${RDK_ROOT_PATH}/rdkc/components/opensource/cvr' if (os.path.isdir('${RDK_ROOT_PATH}/rdkc/components/opensource/cvr')) else ''}"
EXTERNALSRC:pn-dca = "${@'${RDK_ROOT_PATH}/rdk/components/generic/dca' if (os.path.isdir('${RDK_ROOT_PATH}/rdk/components/generic/dca')) else ''}"
EXTERNALSRC:pn-dcmjsonparser = "${@'${RDK_ROOT_PATH}/rdk/components/generic/dcm' if (os.path.isdir('${RDK_ROOT_PATH}/rdk/components/generic/dcm')) else ''}"
EXTERNALSRC:pn-devicesettings = "${@'${RDK_ROOT_PATH}/rdk/components/generic/devicesettings' if (os.path.isdir('${RDK_ROOT_PATH}/rdk/components/generic/devicesettings')) else ''}"
EXTERNALSRC:pn-devicesettings-hal-emulator = "${@'${RDK_ROOT_PATH}/rdk/devices/intel-x86-pc/emulator/devicesettings' if (os.path.isdir('${RDK_ROOT_PATH}/rdk/devices/intel-x86-pc/emulator/devicesettings')) else ''}"
EXTERNALSRC:pn-devicesettings-hal-headers = "${@'${RDK_ROOT_PATH}/rdk/components/generic/devicesettings' if (os.path.isdir('${RDK_ROOT_PATH}/rdk/components/generic/devicesettings')) else ''}"
EXTERNALSRC:pn-devicesettings-hal-raspberrypi = "${@'${RDK_ROOT_PATH}/rdk/devices/raspberrypi/devicesettings' if (os.path.isdir('${RDK_ROOT_PATH}/rdk/devices/raspberrypi/devicesettings')) else ''}"
EXTERNALSRC:pn-diagnostics-snmp2json = "${@'${RDK_ROOT_PATH}/rdk/components/generic/diagnostics/QAM_device' if (os.path.isdir('${RDK_ROOT_PATH}/rdk/components/generic/diagnostics')) else ''}"
EXTERNALSRC:pn-dtcpmgr-noop = "${@'${RDK_ROOT_PATH}/rdk/components/generic/dtcp' if (os.path.isdir('${RDK_ROOT_PATH}/rdk/components/generic/dtcp')) else ''}"
EXTERNALSRC:pn-ermgr = "${@'${RDK_ROOT_PATH}/rdk/components/generic/ermgr' if (os.path.isdir('${RDK_ROOT_PATH}/rdk/components/generic/ermgr')) else ''}"
EXTERNALSRC:pn-fsc = "${@'${RDK_ROOT_PATH}/rdkb/components/opensource/ccsp/FirmwareSanity' if (os.path.isdir('${RDK_ROOT_PATH}/rdkb/components/opensource/ccsp/FirmwareSanity')) else ''}"
EXTERNALSRC:pn-gdbus-client = "${@'${RDK_ROOT_PATH}/components/opensource/gdbus-client' if (os.path.isdir('${RDK_ROOT_PATH}/components/opensource/gdbus-client')) else ''}"
EXTERNALSRC:pn-gst-external-plugin = "${@'${RDK_ROOT_PATH}/rdk/components/generic/gst-plugins-rdk/src/external' if (os.path.isdir('${RDK_ROOT_PATH}/rdk/components/generic/gst-plugins-rdk')) else ''}"
EXTERNALSRC:pn-gst-plugins-playersinkbin-emulator = "${@'${RDK_ROOT_PATH}/rdk/devices/intel-x86-pc/rdkemulator/gst-plugins-rdk/playersinkbin' if (os.path.isdir('${RDK_ROOT_PATH}/rdk/devices/intel-x86-pc/rdkemulator/gst-plugins-rdk/playersinkbin')) else ''}"
EXTERNALSRC:pn-gst-plugins-playersinkbin-rpi = "${@'${RDK_ROOT_PATH}/rdk/devices/raspberrypi/gst-plugins-rdk/playersinkbin' if (os.path.isdir('${RDK_ROOT_PATH}/rdk/devices/raspberrypi/gst-plugins-rdk/playersinkbin')) else ''}"
EXTERNALSRC:pn-gst-plugins-rdk = "${@'${RDK_ROOT_PATH}/rdk/components/generic/gst-plugins-rdk' if (os.path.isdir('${RDK_ROOT_PATH}/rdk/components/generic/gst-plugins-rdk')) else ''}"
EXTERNALSRC:pn-gst-svp-ext = "${@'${RDK_ROOT_PATH}/rdk/components/generic/gst_svp_ext' if (os.path.isdir('${RDK_ROOT_PATH}/rdk/components/generic/gst_svp_ext')) else ''}"
EXTERNALSRC:pn-gstqamtunersrc = "${@'${RDK_ROOT_PATH}/rdk/devices/intel-x86-pc/rdkemulator/gst-plugins-rdk/qamtunersrc' if (os.path.isdir('${RDK_ROOT_PATH}/rdk/devices/intel-x86-pc/rdkemulator/gst-plugins-rdk/qamtunersrc')) else ''}"
EXTERNALSRC:pn-hal-wifi-cfg80211 = "${@'${RDK_ROOT_PATH}/components/opensource/hal-wifi-cfg80211/source/wifi' if (os.path.isdir('${RDK_ROOT_PATH}/components/opensource/hal-wifi-cfg80211')) else ''}"
EXTERNALSRC:pn-hal-voice-asterisk = "${@'${RDK_ROOT_PATH}/components/opensource/hal-voice-asterisk' if (os.path.isdir('${RDK_ROOT_PATH}/components/opensource/hal-voice-asterisk')) else ''}"
EXTERNALSRC:pn-hdmicec = "${@'${RDK_ROOT_PATH}/rdk/components/generic/hdmicec' if (os.path.isdir('${RDK_ROOT_PATH}/rdk/components/generic/hdmicec')) else ''}"
EXTERNALSRC:pn-hdmicecheader = "${@'${RDK_ROOT_PATH}/rdk/components/generic/hdmicecheader' if (os.path.isdir('${RDK_ROOT_PATH}/rdk/components/generic/hdmicecheader')) else ''}"
EXTERNALSRC:pn-hostdataconverter = "${@'${RDK_ROOT_PATH}/rdk/components/generic/sys_mon_tools/hostdataconverter' if (os.path.isdir('${RDK_ROOT_PATH}/rdk/components/generic/sys_mon_tools/hostdataconverter')) else ''}"
EXTERNALSRC:pn-httpclients-utility = "${@'${RDK_ROOT_PATH}/rdkc/components/opensource/httpClients' if (os.path.isdir('${RDK_ROOT_PATH}/rdkc/components/opensource/httpClients')) else ''}"
EXTERNALSRC:pn-hwselftest = "${@'${RDK_ROOT_PATH}/rdk/components/generic/hwselftest' if (os.path.isdir('${RDK_ROOT_PATH}/rdk/components/generic/hwselftest')) else ''}"
EXTERNALSRC:pn-iarm-event-sender = "${@'${RDK_ROOT_PATH}/rdk/components/generic/sys_mon_tools/iarm_event_sender' if (os.path.isdir('${RDK_ROOT_PATH}/rdk/components/generic/sys_mon_tools/iarm_event_sender')) else ''}"
EXTERNALSRC:pn-iarm-query-powerstate = "${@'${RDK_ROOT_PATH}/rdk/components/generic/sys_mon_tools/iarm_query_powerstate' if (os.path.isdir('${RDK_ROOT_PATH}/rdk/components/generic/sys_mon_tools/iarm_query_powerstate')) else ''}"
EXTERNALSRC:pn-iarm-set-powerstate = "${@'${RDK_ROOT_PATH}/rdk/components/generic/sys_mon_tools/iarm_set_powerstate' if (os.path.isdir('${RDK_ROOT_PATH}/rdk/components/generic/sys_mon_tools/iarm_set_powerstate')) else ''}"
EXTERNALSRC:pn-iarmbus = "${@'${RDK_ROOT_PATH}/rdk/components/generic/iarmbus' if (os.path.isdir('${RDK_ROOT_PATH}/rdk/components/generic/iarmbus')) else ''}"
EXTERNALSRC:pn-iarmmgrs = "${@'${RDK_ROOT_PATH}/rdk/components/generic/iarmmgrs' if (os.path.isdir('${RDK_ROOT_PATH}/rdk/components/generic/iarmmgrs')) else ''}"
EXTERNALSRC:pn-iarmmgrs-hal-emulator = "${@'${RDK_ROOT_PATH}/rdk/devices/intel-x86-pc/emulator/iarmmgrs' if (os.path.isdir('${RDK_ROOT_PATH}/rdk/devices/intel-x86-pc/emulator/iarmmgrs')) else ''}"
EXTERNALSRC:pn-iarmmgrs-hal-headers = "${@'${RDK_ROOT_PATH}/rdk/components/generic/iarmmgrsheaders' if (os.path.isdir('${RDK_ROOT_PATH}/rdk/components/generic/iarmmgrsheaders')) else ''}"
EXTERNALSRC:pn-iarmmgrs-hal-raspberrypi = "${@'${RDK_ROOT_PATH}/rdk/devices/raspberrypi/iarmmgrs' if (os.path.isdir('${RDK_ROOT_PATH}/rdk/devices/raspberrypi/iarmmgrs')) else ''}"
EXTERNALSRC:pn-injectedbundle = "${@'${RDK_ROOT_PATH}/rdk/components/generic/injectedbundle' if (os.path.isdir('${RDK_ROOT_PATH}/rdk/components/generic/injectedbundle')) else ''}"
EXTERNALSRC:pn-key-simulator = "${@'${RDK_ROOT_PATH}/rdk/components/generic/sys_mon_tools/key_simulator' if (os.path.isdir('${RDK_ROOT_PATH}/rdk/components/generic/sys_mon_tools/key_simulator')) else ''}"
EXTERNALSRC:pn-ledmgr = "${@'${RDK_ROOT_PATH}/rdk/components/generic/ledmgr' if (os.path.isdir('${RDK_ROOT_PATH}/rdk/components/generic/ledmgr')) else ''}"
EXTERNALSRC:pn-ledmgr-camera = "${@'${RDK_ROOT_PATH}/rdkc/components/opensource/ledmgr' if (os.path.isdir('${RDK_ROOT_PATH}/rdkc/components/opensource/ledmgr')) else ''}"
EXTERNALSRC:pn-ledmgr-headers = "${@'${RDK_ROOT_PATH}/rdk/components/generic/ledmgr' if (os.path.isdir('${RDK_ROOT_PATH}/rdk/components/generic/ledmgr')) else ''}"
EXTERNALSRC:pn-libdacjwt = "${@'${RDK_ROOT_PATH}/components/opensource/dac-sec/libdacjwt' if (os.path.isdir('${RDK_ROOT_PATH}/components/opensource/dac-sec')) else ''}"
EXTERNALSRC:pn-libmntfsimg = "${@'${RDK_ROOT_PATH}/components/opensource/dac-sec/libmntfsimg' if (os.path.isdir('${RDK_ROOT_PATH}/components/opensource/dac-sec')) else ''}"
EXTERNALSRC:pn-libkwk-rdk = "${@'${RDK_ROOT_PATH}/components/opensource/dac-sec/libkwk-rdk' if (os.path.isdir('${RDK_ROOT_PATH}/components/opensource/dac-sec')) else ''}"
EXTERNALSRC:pn-libkwk-rdk-header = "${@'${RDK_ROOT_PATH}/components/opensource/dac-sec/libkwk-rdk' if (os.path.isdir('${RDK_ROOT_PATH}/components/opensource/dac-sec')) else ''}"
EXTERNALSRC:pn-lxapp-bt-audio = "${@'${RDK_ROOT_PATH}/components/opensource/RDK_apps/BluetoothAudio/dist' if (os.path.isdir('${RDK_ROOT_PATH}/components/opensource/RDK_apps')) else ''}"
EXTERNALSRC:pn-lxc-container-generator-native = "${@'${RDK_ROOT_PATH}/rdk/components/generic/lxc-container-generator' if (os.path.isdir('${RDK_ROOT_PATH}/rdk/components/generic/lxc-container-generator')) else ''}"
EXTERNALSRC:pn-lxccpid = "${@'${RDK_ROOT_PATH}/rdk/components/generic/lxccpid' if (os.path.isdir('${RDK_ROOT_PATH}/rdk/components/generic/lxccpid')) else ''}"
EXTERNALSRC:pn-mabr-agent-api = "${@'${RDK_ROOT_PATH}/components/generic/mabr-agent/agent-api' if (os.path.isdir('${RDK_ROOT_PATH}/components/generic/mabr-agent')) else ''}"
EXTERNALSRC:pn-mabr-agent = "${@'${RDK_ROOT_PATH}/components/generic/mabr-agent/agent' if (os.path.isdir('${RDK_ROOT_PATH}/components/generic/mabr-agent')) else ''}"
EXTERNALSRC:pn-media-utils = "${@'${RDK_ROOT_PATH}/rdk/components/generic/media_utils' if (os.path.isdir('${RDK_ROOT_PATH}/rdk/components/generic/media_utils')) else ''}"
EXTERNALSRC:pn-mediastreamer = "${@'${RDK_ROOT_PATH}/rdkc/devices/raspberrypi/mediastreamer' if (os.path.isdir('${RDK_ROOT_PATH}/rdkc/devices/raspberrypi/mediastreamer')) else ''}"
EXTERNALSRC:pn-memstress = "${@'${RDK_ROOT_PATH}/rdk/components/generic/sys_mon_tools/mem_analyser_tools/memstress' if (os.path.isdir('${RDK_ROOT_PATH}/rdk/components/generic/sys_mon_tools/mem_analyser_tools/memstress')) else ''}"
EXTERNALSRC:pn-mfr-data = "${@'${RDK_ROOT_PATH}/rdk/components/generic/sys_mon_tools/mfr_data' if (os.path.isdir('${RDK_ROOT_PATH}/rdk/components/generic/sys_mon_tools/mfr_data')) else ''}"
EXTERNALSRC:pn-mfr-utils = "${@'${RDK_ROOT_PATH}/rdk/components/generic/sys_mon_tools/mfr_utils' if (os.path.isdir('${RDK_ROOT_PATH}/rdk/components/generic/sys_mon_tools/mfr_utils')) else ''}"
EXTERNALSRC:pn-mfrlib-emulator = "${@'${RDK_ROOT_PATH}/rdk/devices/intel-x86-pc/rdkemulator/mfrlibs' if (os.path.isdir('${RDK_ROOT_PATH}/rdk/devices/intel-x86-pc/rdkemulator/mfrlibs')) else ''}"
EXTERNALSRC:pn-mfrlibs-rpi = "${@'${RDK_ROOT_PATH}/rdk/devices/raspberrypi/mfrlibs' if (os.path.isdir('${RDK_ROOT_PATH}/rdk/devices/raspberrypi/mfrlibs')) else ''}"
EXTERNALSRC:pn-moca-hal = "${@'${RDK_ROOT_PATH}/rdk/components/generic/mocahal' if (os.path.isdir('${RDK_ROOT_PATH}/rdk/components/generic/mocahal')) else ''}"
EXTERNALSRC:pn-moca-hal-noop = "${@'${RDK_ROOT_PATH}/rdk/components/generic/mocahal' if (os.path.isdir('${RDK_ROOT_PATH}/rdk/components/generic/mocahal')) else ''}"
EXTERNALSRC:pn-netsrvmgr = "${@'${RDK_ROOT_PATH}/rdk/components/generic/netsrvmgr' if (os.path.isdir('${RDK_ROOT_PATH}/rdk/components/generic/netsrvmgr')) else ''}"
EXTERNALSRC:pn-nlmonitor = "${@'${RDK_ROOT_PATH}/rdk/components/generic/netmonitor' if (os.path.isdir('${RDK_ROOT_PATH}/rdk/components/generic/netmonitor')) else ''}"
EXTERNALSRC:pn-omi = "${@'${RDK_ROOT_PATH}/components/opensource/OMI' if (os.path.isdir('${RDK_ROOT_PATH}/components/opensource/OMI')) else ''}"
EXTERNALSRC:pn-platformmanager = "${@'${RDK_ROOT_PATH}/rdkb/components/opensource/ccsp/PlatformManager' if (os.path.isdir('${RDK_ROOT_PATH}/rdkb/components/opensource/ccsp/PlatformManager')) else ''}"
EXTERNALSRC:pn-plugins = "${@'${RDK_ROOT_PATH}/rdkc/components/opensource/plugins' if (os.path.isdir('${RDK_ROOT_PATH}/rdkc/components/opensource/plugins')) else ''}"
EXTERNALSRC:pn-power-state-monitor = "${@'${RDK_ROOT_PATH}/rdk/components/generic/sys_mon_tools/power-state-monitor' if (os.path.isdir('${RDK_ROOT_PATH}/rdk/components/generic/sys_mon_tools/power-state-monitor')) else ''}"
EXTERNALSRC:pn-pwstream = "${@'${RDK_ROOT_PATH}/rdkc/components/opensource/pwstream' if (os.path.isdir('${RDK_ROOT_PATH}/rdkc/components/opensource/pwstream')) else ''}"
EXTERNALSRC:pn-qtapp = "${@'${RDK_ROOT_PATH}/rdk/components/generic/trm/qtapp/srv' if (os.path.isdir('${RDK_ROOT_PATH}/rdk/components/generic/trm')) else ''}"
EXTERNALSRC:pn-rdk-diagnostics = "${@'${RDK_ROOT_PATH}/rdk/components/generic/diagnostics/QAM_device' if (os.path.isdir('${RDK_ROOT_PATH}/rdk/components/generic/diagnostics')) else ''}"
EXTERNALSRC:pn-rdk-easymesh-controller = "${@'${RDK_ROOT_PATH}/rdkb/components/opensource/ccsp/RdkEasyMeshController' if (os.path.isdir('${RDK_ROOT_PATH}/rdkb/components/opensource/ccsp/RdkEasyMeshController')) else ''}"
EXTERNALSRC:pn-rdk-gstreamer-utils = "${@'${RDK_ROOT_PATH}/rdk/components/opensource/gstreamer-direct-platform' if (os.path.isdir('${RDK_ROOT_PATH}/rdk/components/opensource/gstreamer-direct-platform')) else ''}"
EXTERNALSRC:pn-rdk-oss-ssa = "${@'${RDK_ROOT_PATH}/rdk/components/generic/rdkssa' if (os.path.isdir('${RDK_ROOT_PATH}/rdk/components/generic/rdkssa')) else ''}"
EXTERNALSRC:pn-rdkapps = "${@'${RDK_ROOT_PATH}/rdk/components/generic/rdkapps' if (os.path.isdir('${RDK_ROOT_PATH}/rdk/components/generic/rdkapps')) else ''}"
EXTERNALSRC:pn-rdkat = "${@'${RDK_ROOT_PATH}/rdk/components/generic/rdkat' if (os.path.isdir('${RDK_ROOT_PATH}/rdk/components/generic/rdkat')) else ''}"
EXTERNALSRC:pn-rdkbrowser2 = "${@'${RDK_ROOT_PATH}/rdk/components/generic/rdkbrowser2' if (os.path.isdir('${RDK_ROOT_PATH}/rdk/components/generic/rdkbrowser2')) else ''}"
EXTERNALSRC:pn-rdkmediaplayer = "${@'${RDK_ROOT_PATH}/rdk/components/generic/rdkmediaplayer' if (os.path.isdir('${RDK_ROOT_PATH}/rdk/components/generic/rdkmediaplayer')) else ''}"
EXTERNALSRC:pn-rdkresidentapp = "${@'${RDK_ROOT_PATH}/rdk/components/generic/appmanager' if (os.path.isdir('${RDK_ROOT_PATH}/rdk/components/generic/appmanager')) else ''}"
EXTERNALSRC:pn-rdkservice-lisa = "${@'${RDK_ROOT_PATH}/components/opensource/LISA' if (os.path.isdir('${RDK_ROOT_PATH}/components/opensource/LISA')) else ''}"
EXTERNALSRC:pn-rdkshell = "${@'${RDK_ROOT_PATH}/components/opensource/RDKShell' if (os.path.isdir('${RDK_ROOT_PATH}/components/opensource/RDKShell')) else ''}"
EXTERNALSRC:pn-rdkversion = "${@'${RDK_ROOT_PATH}/rdk/components/generic/rdkversion' if (os.path.isdir('${RDK_ROOT_PATH}/rdk/components/generic/rdkversion')) else ''}"
EXTERNALSRC:pn-residentui = "${@'${RDK_ROOT_PATH}/components/opensource/RDK_apps/accelerator-home-ui/dist' if (os.path.isdir('${RDK_ROOT_PATH}/components/opensource/RDK_apps')) else ''}"
EXTERNALSRC:pn-rialto = "${@'${RDK_ROOT_PATH}/components/opensource/rialto' if (os.path.isdir('${RDK_ROOT_PATH}/components/opensource/rialto')) else ''}"
EXTERNALSRC:pn-rialto-gstreamer = "${@'${RDK_ROOT_PATH}/components/opensource/rialto-gstreamer' if (os.path.isdir('${RDK_ROOT_PATH}/components/opensource/rialto-gstreamer')) else ''}"
EXTERNALSRC:pn-rialto-ocdm = "${@'${RDK_ROOT_PATH}/components/opensource/rialto-ocdm' if (os.path.isdir('${RDK_ROOT_PATH}/components/opensource/rialto-ocdm')) else ''}"
EXTERNALSRC:pn-rmfapp = "${@'${RDK_ROOT_PATH}/rdk/components/generic/mediaframework/rmfApp' if (os.path.isdir('${RDK_ROOT_PATH}/rdk/components/generic/mediaframework')) else ''}"
EXTERNALSRC:pn-rmfgeneric = "${@'${RDK_ROOT_PATH}/rdk/components/generic/mediaframework' if (os.path.isdir('${RDK_ROOT_PATH}/rdk/components/generic/mediaframework')) else ''}"
EXTERNALSRC:pn-rmfgenericheaders = "${@'${RDK_ROOT_PATH}/rdk/components/generic/mediaframework' if (os.path.isdir('${RDK_ROOT_PATH}/rdk/components/generic/mediaframework')) else ''}"
EXTERNALSRC:pn-rmfosal = "${@'${RDK_ROOT_PATH}/rdk/components/generic/mediaframework/osal' if (os.path.isdir('${RDK_ROOT_PATH}/rdk/components/generic/mediaframework')) else ''}"
EXTERNALSRC:pn-rms = "${@'${RDK_ROOT_PATH}/rdkc/components/opensource/rms' if (os.path.isdir('${RDK_ROOT_PATH}/rdkc/components/opensource/rms')) else ''}"
EXTERNALSRC:pn-rpcserver = "${@'${RDK_ROOT_PATH}/components/opensource/rpcserver' if (os.path.isdir('${RDK_ROOT_PATH}/components/opensource/rpcserver')) else ''}"
EXTERNALSRC:pn-rtremote = "${@'${RDK_ROOT_PATH}/components/opensource/rtRemote' if (os.path.isdir('${RDK_ROOT_PATH}/components/opensource/rtRemote')) else ''}"
EXTERNALSRC:pn-runsnmp = "${@'${RDK_ROOT_PATH}/rdk/components/generic/mediaframework/snmp/runsnmp' if (os.path.isdir('${RDK_ROOT_PATH}/rdk/components/generic/mediaframework')) else ''}"
EXTERNALSRC:pn-si-cache-parser = "${@'${RDK_ROOT_PATH}/rdk/components/generic/sys_mon_tools/si_cache_parser' if (os.path.isdir('${RDK_ROOT_PATH}/rdk/components/generic/sys_mon_tools/si_cache_parser')) else ''}"
EXTERNALSRC:pn-skillmapper = "${@'${RDK_ROOT_PATH}/rdk/components/generic/avs/alexa_skill_mapper' if (os.path.isdir('${RDK_ROOT_PATH}/rdk/components/generic/avs/alexa_skill_mapper')) else ''}"
EXTERNALSRC:pn-smartmon = "${@'${RDK_ROOT_PATH}/components/opensource/smartmon' if (os.path.isdir('${RDK_ROOT_PATH}/components/opensource/smartmon')) else ''}"
EXTERNALSRC:pn-sso = "${@'${RDK_ROOT_PATH}/rdkb/components/generic/sso' if (os.path.isdir('${RDK_ROOT_PATH}/rdkb/components/generic/sso')) else ''}"
EXTERNALSRC:pn-streamfs = "${@'${RDK_ROOT_PATH}/rdk/components/generic/streamfs' if (os.path.isdir('${RDK_ROOT_PATH}/rdk/components/generic/streamfs')) else ''}"
EXTERNALSRC:pn-streamfs-fcc = "${@'${RDK_ROOT_PATH}/rdk/components/generic/streamfs_fcc' if (os.path.isdir('${RDK_ROOT_PATH}/rdk/components/generic/streamfs_fcc')) else ''}"
EXTERNALSRC:pn-sys-resource = "${@'${RDK_ROOT_PATH}/rdk/components/generic/sys_mon_tools/sys_resource' if (os.path.isdir('${RDK_ROOT_PATH}/rdk/components/generic/sys_mon_tools/sys_resource')) else ''}"
EXTERNALSRC:pn-sys-utils = "${@'${RDK_ROOT_PATH}/rdk/components/generic/sys_mon_tools/sys_utils' if (os.path.isdir('${RDK_ROOT_PATH}/rdk/components/generic/sys_mon_tools/sys_utils')) else ''}"
EXTERNALSRC:pn-syslog-helper = "${@'${RDK_ROOT_PATH}/rdk/components/generic/syslog_helper' if (os.path.isdir('${RDK_ROOT_PATH}/rdk/components/generic/syslog_helper')) else ''}"
EXTERNALSRC:pn-tdk = "${@'${RDK_ROOT_PATH}/rdkv/tools/tdkv' if (os.path.isdir('${RDK_ROOT_PATH}/rdkv/tools/tdkv')) else ''}"
EXTERNALSRC:pn-tdk-b = "${@'${RDK_ROOT_PATH}/rdkb/tools/tdkb' if (os.path.isdir('${RDK_ROOT_PATH}/rdkb/tools/tdkb')) else ''}"
EXTERNALSRC:pn-tdk-c = "${@'${RDK_ROOT_PATH}/rdkc/tools/tdkc' if (os.path.isdir('${RDK_ROOT_PATH}/rdkc/tools/tdkc')) else ''}"
EXTERNALSRC:pn-tenablehdcp = "${@'${RDK_ROOT_PATH}/rdk/components/generic/rmf_tools/tenableHDCP' if (os.path.isdir('${RDK_ROOT_PATH}/rdk/components/generic/rmf_tools/tenableHDCP')) else ''}"
EXTERNALSRC:pn-thumbnail = "${@'${RDK_ROOT_PATH}/rdkc/components/opensource/thumbnail' if (os.path.isdir('${RDK_ROOT_PATH}/rdkc/components/opensource/thumbnail')) else ''}"
EXTERNALSRC:pn-tr69hostif-headers = "${@'${RDK_ROOT_PATH}/rdk/components/generic/tr69hostif' if (os.path.isdir('${RDK_ROOT_PATH}/rdk/components/generic/tr69hostif')) else ''}"
EXTERNALSRC:pn-tr69hostif = "${@'${RDK_ROOT_PATH}/rdk/components/generic/tr69hostif' if (os.path.isdir('${RDK_ROOT_PATH}/rdk/components/generic/tr69hostif')) else ''}"
EXTERNALSRC:pn-trh = "${@'${RDK_ROOT_PATH}/rdk/components/generic/mediaframework/trh' if (os.path.isdir('${RDK_ROOT_PATH}/rdk/components/generic/mediaframework')) else ''}"
EXTERNALSRC:pn-trm-common = "${@'${RDK_ROOT_PATH}/rdk/components/generic/trm/common/src' if (os.path.isdir('${RDK_ROOT_PATH}/rdk/components/generic/trm')) else ''}"
EXTERNALSRC:pn-trmmgr = "${@'${RDK_ROOT_PATH}/rdk/components/generic/trm/diag' if (os.path.isdir('${RDK_ROOT_PATH}/rdk/components/generic/trm')) else ''}"
EXTERNALSRC:pn-tts = "${@'${RDK_ROOT_PATH}/rdk/components/generic/ttsengine' if (os.path.isdir('${RDK_ROOT_PATH}/rdk/components/generic/ttsengine')) else ''}"
EXTERNALSRC:pn-tvsettings = "${@'${RDK_ROOT_PATH}/rdk/components/opensource/tvsettings' if (os.path.isdir('${RDK_ROOT_PATH}/rdk/components/opensource/tvsettings')) else ''}"
EXTERNALSRC:pn-tvsettings-hal-noop = "${@'${RDK_ROOT_PATH}/rdk/components/opensource/tvsettings/stubs' if (os.path.isdir('${RDK_ROOT_PATH}/rdk/components/opensource/tvsettings/stubs')) else ''}"
EXTERNALSRC:pn-tvsettings-plugins = "${@'${RDK_ROOT_PATH}/rdk/components/opensource/tvsettings/tvmgr-plugins' if (os.path.isdir('${RDK_ROOT_PATH}/rdk/components/opensource/tvsettings')) else ''}"
EXTERNALSRC:pn-udhcpc-opt43 = "${@'${RDK_ROOT_PATH}/rdk/components/generic/sys_mon_tools/udhcpc-opt43' if (os.path.isdir('${RDK_ROOT_PATH}/rdk/components/generic/sys_mon_tools/udhcpc-opt43')) else ''}"
EXTERNALSRC:pn-usbctrl = "${@'${RDK_ROOT_PATH}/rdk/components/generic/libusbctrl' if (os.path.isdir('${RDK_ROOT_PATH}/rdk/components/generic/libusbctrl')) else ''}"
EXTERNALSRC:pn-waymetric = "${@'${RDK_ROOT_PATH}/components/opensource/waymetric' if (os.path.isdir('${RDK_ROOT_PATH}/components/opensource/waymetric')) else ''}"
EXTERNALSRC:pn-webconfig-framework = "${@'${RDK_ROOT_PATH}/rdk/components/generic/WebconfigFramework' if (os.path.isdir('${RDK_ROOT_PATH}/rdk/components/generic/WebconfigFramework')) else ''}"
EXTERNALSRC:pn-websocketclient = "${@'${RDK_ROOT_PATH}/components/opensource/websocketclient' if (os.path.isdir('${RDK_ROOT_PATH}/components/opensource/websocketclient')) else ''}"
EXTERNALSRC:pn-westeros = "${@'${RDK_ROOT_PATH}/components/opensource/westeros' if (os.path.isdir('${RDK_ROOT_PATH}/components/opensource/westeros')) else ''}"
EXTERNALSRC:pn-westeros-soc-drm = "${@'${RDK_ROOT_PATH}/components/opensource/westeros/drm' if (os.path.isdir('${RDK_ROOT_PATH}/components/opensource/westeros')) else ''}"
EXTERNALSRC:pn-westeros-soc-emu = "${@'${RDK_ROOT_PATH}/devices/intel-x86-pc/rdkri/westeros' if (os.path.isdir('${RDK_ROOT_PATH}/devices/intel-x86-pc/rdkri/westeros')) else ''}"
EXTERNALSRC:pn-westeros-soc-rpi = "${@'${RDK_ROOT_PATH}/components/opensource/westeros' if (os.path.isdir('${RDK_ROOT_PATH}/components/opensource/westeros')) else ''}"
EXTERNALSRC:pn-wifi-hal-generic = "${@'${RDK_ROOT_PATH}/rdk/components/generic/wifi' if (os.path.isdir('${RDK_ROOT_PATH}/rdk/components/generic/wifi')) else ''}"
EXTERNALSRC:pn-wifi-hal-headers = "${@'${RDK_ROOT_PATH}/rdk/components/generic/wifi' if (os.path.isdir('${RDK_ROOT_PATH}/rdk/components/generic/wifi')) else ''}"
EXTERNALSRC:pn-wsproxy = "${@'${RDK_ROOT_PATH}/rdk/components/generic/trm/wsproxy' if (os.path.isdir('${RDK_ROOT_PATH}/rdk/components/generic/trm')) else ''}"
EXTERNALSRC:pn-xdialserver = "${@'${RDK_ROOT_PATH}/components/opensource/xdialserver/server' if (os.path.isdir('${RDK_ROOT_PATH}/components/opensource/xdialserver')) else ''}"
EXTERNALSRC:pn-xr-speech-avs = "${@'${RDK_ROOT_PATH}/rdk/components/generic/avs/xr-speech-avs-sdk/xr-speech-avs' if (os.path.isdir('${RDK_ROOT_PATH}/rdk/components/generic/avs/xr-speech-avs-sdk')) else ''}"
EXTERNALSRC:pn-xr-voice-sdk = "${@'${RDK_ROOT_PATH}/rdk/components/generic/xr-voice-sdk' if (os.path.isdir('${RDK_ROOT_PATH}/rdk/components/generic/xr-voice-sdk')) else ''}"
EXTERNALSRC:pn-xr-voice-sdk-headers = "${@'${RDK_ROOT_PATH}/rdk/components/generic/xr-voice-sdk' if (os.path.isdir('${RDK_ROOT_PATH}/rdk/components/generic/xr-voice-sdk')) else ''}"
```
