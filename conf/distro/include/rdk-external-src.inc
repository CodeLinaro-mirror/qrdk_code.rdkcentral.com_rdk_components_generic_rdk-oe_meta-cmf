## conf/layer.conf
```bitbake
BBPATH .= ":${LAYERDIR}"

BBFILES += "\
            ${LAYERDIR}/recipes-*/*/*.bb \
            ${LAYERDIR}/recipes-*/*/*/*.bb \
            ${LAYERDIR}/recipes-*/*/*.bbappend \
            ${LAYERDIR}/recipes-*/*/*/*.bbappend \
           "

BBFILE_COLLECTIONS += "cmf"
BBFILE_PATTERN_cmf := "^${LAYERDIR}/"
#BBFILE_PRIORITY_cmf = "25"

LAYERSERIES_COMPAT_cmf = "dunfell"

# Additional license directories.
LICENSE_PATH += "${LAYERDIR}/licenses"

LAYERDEPENDS_cmf = "rdk"

RDK_ROOT_PATH = "${LAYERDIR}/.."

require conf/distro/include/rdkcmf.inc
require conf/distro/include/rdk-external-src.inc
require conf/distro/include/rdk-versions.inc

PREFERRED_PROVIDER_virtual/samplemedia ?= "linaro-samplemedia"
PREFERRED_VERSION_lighttpd = "1.4.39"

#Temporary bbmasks for components that have not been opensourced yet
BBMASK .= "|meta-rdk-video/recipes-extended/clnl/"
BBMASK .= "|meta-rdk-video/recipes-extended/ctrlm/ctrlm-factory.bb"
BBMASK .= "|meta-rdk-video/recipes-extended/ctrlm/ctrlm-factory-headers.bb"
BBMASK .= "|meta-rdk-broadband/recipes-ccsp/ccsp/batterymgr.bb"
BBMASK .= "|meta-rdk-broadband/recipes-ccsp/ccsp/lanmanager.bb"
BBMASK .= "|meta-rdk-broadband/recipes-ccsp/ccsp/platformmanager.bb"
BBMASK .= "|meta-rdk-broadband/recipes-ccsp/ccsp/gatewaymanager.bb"

# The linux-libc-headers recipe in meta-rdk-ext is for a specific Comcast platform
# and not applicable to CMF platforms
BBMASK_append_morty .= "|meta-rdk-ext/recipes-kernel/linux/linux-libc-headers_3.14.bb"

# Masking the duplicate googletest recipe in meta-rdk-ext. Use the one in
# meta-openembedded
BBMASK .= "|meta-rdk-ext/recipes-test/googletest/"

DISTRO_FEATURES_append_arm = " ld-is-gold"
DISTRO_FEATURES_append_x86 = " ld-is-gold"
DISTRO_FEATURES_append_dunfell = " dunfell"
DISTRO_FEATURES_append_dunfell = " virtualization"
DISTRO_FEATURES_append_dunfell = " ssl-1.1.1"

PREFERRED_VERSION_xfsprogs_morty = "4.8.0"
PREFERRED_VERSION_xfsprogs_dunfell = "5.2.1"
```
